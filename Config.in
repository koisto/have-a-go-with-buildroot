## Config.in
```kconfig
source "$BR2_EXTERNAL_HAVEAGO_PATH/package/myecho/Config.in"
source "$BR2_EXTERNAL_HAVEAGO_PATH/package/kernelhello/Config.in"
```

## configs/haveago_defconfig
```kconfig
BR2_arm=y
BR2_arm1176jzf_s=y
BR2_JLEVEL=2
BR2_GLOBAL_PATCH_DIR="$(BR2_EXTERNAL_HAVEAGO_PATH)/patches"
BR2_PACKAGE_HOST_LINUX_HEADERS_CUSTOM_4_14=y
BR2_TOOLCHAIN_BUILDROOT_CXX=y
BR2_TARGET_GENERIC_HOSTNAME="haveago"
BR2_TARGET_GENERIC_ISSUE="Welcome to Haveago Linux"
BR2_SYSTEM_DHCP="eth0"
BR2_ROOTFS_POST_BUILD_SCRIPT="board/raspberrypi/post-build.sh"
BR2_ROOTFS_POST_IMAGE_SCRIPT="board/raspberrypi/post-image.sh"
BR2_LINUX_KERNEL=y
BR2_LINUX_KERNEL_CUSTOM_TARBALL=y
BR2_LINUX_KERNEL_CUSTOM_TARBALL_LOCATION="$(call github,raspberrypi,linux,83b36f98e1a48d143f0b466fcf9f8c4e382c9a1c)/linux-83b36f98e1a48d143f0b466fcf9f8c4e382c9a1c.tar.gz"
BR2_LINUX_KERNEL_DEFCONFIG="bcmrpi"
BR2_LINUX_KERNEL_DTS_SUPPORT=y
BR2_LINUX_KERNEL_INTREE_DTS_NAME="bcm2708-rpi-b bcm2708-rpi-b-plus bcm2708-rpi-cm"
BR2_PACKAGE_RPI_FIRMWARE=y
# BR2_PACKAGE_RPI_FIRMWARE_INSTALL_DTB_OVERLAYS is not set
BR2_PACKAGE_MICROPYTHON=y
BR2_TARGET_ROOTFS_EXT2=y
BR2_TARGET_ROOTFS_EXT2_4=y
# BR2_TARGET_ROOTFS_TAR is not set
BR2_PACKAGE_HOST_DOSFSTOOLS=y
BR2_PACKAGE_HOST_GENIMAGE=y
BR2_PACKAGE_HOST_MTOOLS=y
```

## package/kernelhello/Config.in
```kconfig
config BR2_PACKAGE_KERNELHELLO
	bool "KernelHello"
	help
		A simple kernel module.
```

## package/myecho/Config.in
```kconfig
config BR2_PACKAGE_MYECHO
	bool "Myecho"
	help
		A simple echo program that is built with a makefile.
```
